## main/Kconfig.projbuild
```kconfig
menu "Application Configuration"

	config GPIO_RANGE_MAX
		int
		default 33 if IDF_TARGET_ESP32
		default 46 if IDF_TARGET_ESP32S2
		default 19 if IDF_TARGET_ESP32C3
		default 48 if IDF_TARGET_ESP32S3

	choice MODEL
		prompt "Model"
		default MODEL_MCP41010
		help
			Select model.
		config MODEL_MCP41010
			bool "MCP41010"
			help
				MCP41010(Single 10K)
		config MODEL_MCP41050
			bool "MCP41050"
			help
				MCP41050(Single 50K)
		config MODEL_MCP41100
			bool "MCP41100"
			help
				MCP41100(Single 100K)
		config MODEL_MCP42010
			bool "MCP42010"
			help
				MCP42100(Dual 10K)
		config MODEL_MCP42050
			bool "MCP42050"
			help
				MCP42050(Dual 50K)
		config MODEL_MCP42100
			bool "MCP42100"
			help
				MCP42100(Dual 100K)
	endchoice

	config MOSI_GPIO
		int "MOSI GPIO number"
		range 0 GPIO_RANGE_MAX
		default 23 if IDF_TARGET_ESP32
		default 35 if IDF_TARGET_ESP32S2
		default 0  if IDF_TARGET_ESP32C3
		help
			GPIO number (IOxx) to SPI MOSI.
			Some GPIOs are used for other purposes (flash connections, etc.) and cannot be used to MOSI.
			On the ESP32, GPIOs 35-39 are input-only so cannot be used as outputs.
			On the ESP32-S2, GPIO 46 is input-only so cannot be used as outputs.

	config SCLK_GPIO
		int "SCLK GPIO number"
		range 0 GPIO_RANGE_MAX
		default 18 if IDF_TARGET_ESP32
		default 36 if IDF_TARGET_ESP32S2
		default 1  if IDF_TARGET_ESP32C3
		help
			GPIO number (IOxx) to SPI SCLK.
			Some GPIOs are used for other purposes (flash connections, etc.) and cannot be used to SCLK.
			On the ESP32, GPIOs 35-39 are input-only so cannot be used as outputs.
			On the ESP32-S2, GPIO 46 is input-only so cannot be used as outputs.

	config CS_GPIO
		int "CS GPIO number"
		range 0 GPIO_RANGE_MAX
		default 5  if IDF_TARGET_ESP32
		default 34 if IDF_TARGET_ESP32S2
		default 5  if IDF_TARGET_ESP32C3
		help
			GPIO number (IOxx) to SPI CS.
			Some GPIOs are used for other purposes (flash connections, etc.) and cannot be used to CS.
			On the ESP32, GPIOs 35-39 are input-only so cannot be used as outputs.
			On the ESP32-S2, GPIO 46 is input-only so cannot be used as outputs.

endmenu
```
